## examples/esp-idf/01_ws2812_led/sdkconfig.defaults
```kconfig
CONFIG_IDF_TARGET="esp32s3"
CONFIG_ESP_DEFAULT_CPU_FREQ_MHZ_240=y
CONFIG_ESP_CONSOLE_USB_SERIAL_JTAG=y
CONFIG_ESP_CONSOLE_SECONDARY_NONE=y
CONFIG_FREERTOS_HZ=1000
CONFIG_ESP_MAIN_TASK_STACK_SIZE=4096
```

## examples/esp-idf/03_epaper_2_9/main/Kconfig.projbuild
```kconfig
menu "03 e-Paper display"

choice EPAPER_DEMO_MODE
    prompt "Display mode"
    default EPAPER_DEMO_FUNCTIONAL
    help
        Functional displays status and periodically updates the counter.
        Clear screen refreshes to white once, then puts the panel to sleep.

    config EPAPER_DEMO_FUNCTIONAL
        bool "Functional (customer default)"

    config EPAPER_DEMO_CLEAR
        bool "Clear screen (full white, then sleep)"
        help
            Clear the entire display to white with one full refresh on
            each boot, then put the panel to sleep and keep the blank
            screen. No text or periodic refresh is shown. Select
            Functional again and rebuild for normal customer firmware.
endchoice

endmenu
```

## examples/esp-idf/03_epaper_2_9/sdkconfig.defaults
```kconfig
CONFIG_IDF_TARGET="esp32s3"
CONFIG_ESPTOOLPY_FLASHMODE_QIO=y
CONFIG_ESP_DEFAULT_CPU_FREQ_MHZ_240=y
CONFIG_ESP_CONSOLE_USB_SERIAL_JTAG=y
CONFIG_ESP_CONSOLE_SECONDARY_NONE=y
CONFIG_FREERTOS_HZ=1000
CONFIG_LV_COLOR_DEPTH_16=y
CONFIG_LV_MEM_CUSTOM=y
CONFIG_LV_MEMCPY_MEMSET_STD=y
CONFIG_LV_FONT_MONTSERRAT_14=y
CONFIG_ESP_MAIN_TASK_STACK_SIZE=8192
CONFIG_LV_BUILD_EXAMPLES=n
```

## examples/esp-idf/04_bat_axp2602/main/Kconfig.projbuild
```kconfig
menu "AXP2602 Battery Gauge Example"

    config EXAMPLE_AXP2602_POLL_INTERVAL_MS
        int "Battery polling interval (ms)"
        range 1000 60000
        default 30000

endmenu
```

## examples/esp-idf/11_LoRaWAN_ABP/sdkconfig.defaults
```kconfig
CONFIG_IDF_TARGET="esp32s3"
CONFIG_ESP_CONSOLE_USB_SERIAL_JTAG=y
CONFIG_ESP_CONSOLE_SECONDARY_NONE=y
CONFIG_ESPTOOLPY_FLASHSIZE_16MB=y
CONFIG_FREERTOS_HZ=1000
CONFIG_ESP_MAIN_TASK_STACK_SIZE=12288
CONFIG_LV_COLOR_DEPTH_16=y
```
